## CMakeLists.txt
```
# SPDX-License-Identifier: Apache-2.0

cmake_minimum_required(VERSION 3.13.1)

find_package(Zephyr REQUIRED HINTS $ENV{ZEPHYR_BASE})
project(mercury)

FILE(GLOB app_sources src/*.c)
target_sources(app PRIVATE ${app_sources})

zephyr_code_relocate(src/fwupd.c SRAM)
zephyr_linker_sources(SECTIONS custom-sections.ld)
```

## prj.conf
```kconfig
# allow rebooting from within the firmware (so we can do upgrades)
CONFIG_REBOOT=y

# allow writing to the SOC flash (for firmware upgrades)
CONFIG_FLASH=y
CONFIG_SOC_FLASH_NRF=y
CONFIG_FLASH_PAGE_LAYOUT=y
CONFIG_MPU_ALLOW_FLASH_WRITE=y
CONFIG_SOC_FLASH_NRF_EMULATE_ONE_BYTE_WRITE_ACCESS=y

#special nrf flash stuff
CONFIG_SOC_FLASH_NRF_PARTIAL_ERASE=y
CONFIG_SOC_FLASH_NRF_UICR=y

#code relocation for the firmware upgrade code CONFIG_CODE_DATA_RELOCATION=y
CONFIG_CODE_DATA_RELOCATION=y
CONFIG_HAVE_CUSTOM_LINKER_SCRIPT=y
CONFIG_CUSTOM_LINKER_SCRIPT="upd_reloc.ld"
CONFIG_COVERAGE=n

#enable the hardware RNG
CONFIG_HARDWARE_DEVICE_CS_GENERATOR=n

#required flags for BT-Mesh
CONFIG_BT=y
CONFIG_BT_TINYCRYPT_ECC=y
CONFIG_BT_OBSERVER=y
CONFIG_BT_BROADCASTER=y

CONFIG_BT_MESH=y
CONFIG_BT_MESH_RELAY=y
CONFIG_BT_MESH_SUBNET_COUNT=1
CONFIG_BT_MESH_APP_KEY_COUNT=1
CONFIG_BT_MESH_MODEL_GROUP_COUNT=2
CONFIG_BT_MESH_ADV_BUF_COUNT=10
CONFIG_BT_MESH_LABEL_COUNT=0
CONFIG_BT_MESH_PB_ADV=n
CONFIG_BT_MESH_CFG_CLI=y


#has to be 8. otherwise node crashes
CONFIG_BT_MESH_LOOPBACK_BUFS=8

#max 29B, 1 SEG = 12B, so 3
CONFIG_BT_MESH_TX_SEG_MAX=3

#no of simultaneous msgs = no of nodes 4
CONFIG_BT_MESH_TX_SEG_MSG_COUNT=4
CONFIG_BT_MESH_RX_SEG_MSG_COUNT=4
#default
CONFIG_BT_MESH_CRPL=128
CONFIG_BT_MESH_RPL_STORE_TIMEOUT=120
#cache size = max sdu
CONFIG_BT_MESH_MSG_CACHE_SIZE=36

CONFIG_BT_MESH_SENSOR_CLI=n
CONFIG_BT_MESH_SENSOR_SRV=n

CONFIG_BT_SETTINGS=y
CONFIG_BT_MESH_RPL_STORE_TIMEOUT=600

#Things for SPI
CONFIG_GPIO=y

#not used- tracing support takes too much stack memory
CONFIG_STDOUT_CONSOLE=n
# enable to use thread names
CONFIG_THREAD_NAME=n
CONFIG_SEGGER_SYSTEMVIEW=n
CONFIG_USE_SEGGER_RTT=n
CONFIG_TRACING=n

#k_malloc
CONFIG_HEAP_MEM_POOL_SIZE=512
```

## src/main.c
```c
#include "buildcfg.h"
#include "main.h"
#include "led.h"
#include "hg_mesh.h"
#include "hg_netMgr.h"
#if NODETYPE == NODETYPE_BMS
#include "app_master.h"
#elif NODETYPE == NODETYPE_CMB
#include "app_slave.h"
#endif

#ifndef NODETYPE
#error NODETYPE undefined, unable to generate a valid image
#endif

extern void mercury_preload_RXLine(char *dest, uint8_t *rSize, uint16_t timeout);
extern void mercury_preload_disableMPU(void);

extern void mercury_fwupd_entryPoint(void);
extern void mercury_fwupd_stageF(void);

#if NODETYPE == NODETYPE_BMS

//struct k_thread listen_thread;
//K_THREAD_STACK_DEFINE(listen_stack, STACK_SIZE);

struct k_thread diag_thread;
K_THREAD_STACK_DEFINE(diag_stack, STACK_SIZE);

struct k_thread main_thread;
K_THREAD_STACK_DEFINE(main_stack, STACK_SIZE);

#elif  NODETYPE == NODETYPE_CMB

struct k_thread main_thread;
K_THREAD_STACK_DEFINE(main_stack, STACK_SIZE);

struct k_thread polling_thread;
K_THREAD_STACK_DEFINE(polling_stack, STACK_SIZE);

#endif


void main(void)
{
	//Disable any special memory protection stuff that might impede fwupd
	mercury_preload_disableMPU();

	//Initialise the mercury LED stuff so we can do blinky
	mercury_led_init();
	mercury_led_flash(10);

	printk("MErcury system startup\n");

	//Firmware update detect
	{
		uint32_t sTime = k_cycle_get_32();
		char	 buffer[64];
		uint8_t	 dSize = 0;

		//Wait for 15 seconds to see if anything comes in over UART
		while (k_cycle_get_32() - sTime < 15 * 1000) {
			mercury_preload_RXLine(buffer, &dSize, 100);

			//Something came in over UART, lets do things!
			if (dSize > 0) {
				//Should we expect firmware data to follow?
				if (strncmp(buffer, "fwupd", 5) == 0) {
					mercury_fwupd_entryPoint();
				}
			}
		}
	}
	
	#if NODETYPE == NODETYPE_BMS
	mercury_bms_init();
	initConfigSt(); //not used in anyway yet. just writing all config to struct
	#elif NODETYPE == NODETYPE_CMB
	mercury_cmb_init();
	#endif

	//Bring up the mesh
	mercury_mesh_init();

	#if NODETYPE == NODETYPE_CMB
	mercury_acquire_nodeAddress();
	#endif

	#if NODETYPE == NODETYPE_BMS
	mercury_mesh_forming();
	

	k_thread_create(&main_thread, main_stack, STACK_SIZE,
	mercury_main_bms, NULL, NULL, NULL,
	MAIN_THREAD_PRIO, K_INHERIT_PERMS, K_NO_WAIT);

	k_thread_create(&diag_thread, diag_stack, STACK_SIZE,
	diag_fn, NULL, NULL, NULL,
	DIAG_THREAD_PRIO, K_INHERIT_PERMS, K_NO_WAIT);

#elif NODETYPE == NODETYPE_CMB
	k_thread_create(&polling_thread, polling_stack, STACK_SIZE,
	polling_fn, NULL, NULL, NULL,
	POLL_THREAD_PRIO, K_INHERIT_PERMS, K_NO_WAIT);

	k_thread_create(&main_thread, main_stack, STACK_SIZE,
	mercury_main_cmb, NULL, NULL, NULL,
	MAIN_THREAD_PRIO, K_INHERIT_PERMS, K_MSEC(50));

	#endif
}
```

## src/app_master.c
```c
#include "buildcfg.h"

#if NODETYPE == NODETYPE_BMS

#include "app_master.h"
#include "led.h"
#include "fnv.h"
#include "hg_mesh.h"
#include "hg_netMgr.h"
#include "hg_test.h"

void diag_fn(void *p1, void *p2, void *p3);
void mercury_main_bms(void *p1, void *p2, void *p3);

extern struct k_thread diag_thread;
extern struct k_thread listen_thread;

extern hgNetState NetState;
extern t_bmsSt systemStateLog[NODES_NUM];

extern struct k_timer ok_timeout_timer;
extern uint8_t timer_started_node;

void blink()
{
	mercury_led_flash(50);
	k_msleep(50);
	mercury_led_flash(50);
	k_msleep(50);
}


void trustFunc(t_rxCvPkt *rxmsg){
//empty
}

int crc16Check(t_rxCvPkt *rxmsg){
    int ret=0;
    uint16_t crc = crc16_ansi(rxmsg->data,LTC_NCELLS);
    if(crc == rxmsg->pec)
	ret = 1;
    else{
	printk("ERR: PEC FAILED for %d (token: %d): Rx: %d, Exp from data: %d\n",rxmsg->addr,rxmsg->token,rxmsg->pec, crc );
    }
    return ret;
}

void diag_checkNodePresence() //enters always forming() if one node crashes
{
    uint32_t now = k_uptime_get_32();
    uint32_t lastNodeRx;
    uint32_t diff;
    if(NetState.hm.currSys != STARTUP_NODATA)//prevent it from being entered at startup
    {
	  for (uint16_t i = 0; i < NODES_NUM; i++) 
	  {
	      lastNodeRx = NetState.client[i].diag.lastReceivedOk;
	      diff = now-lastNodeRx;
	      if(diff>CMB_MSG_TIMEOUT &&NetState.client[i].diag.isActive==1){ //during that time all the nodes turn inactive so this is not working just for one node
		  mercury_netMgr_updateNodeState(i+BASE_ADDR,INACTIVE);
		  printk("decreasing %lu\n",lastNodeRx);
		  NetState.hm.active--;
		  NetState.client[i].diag.isActive = 0; //joining timestamp of a node

	      }
	  }
	  if(NetState.hm.active==0){ //not working
	      printk("ERR: No active nodes!\n");
	      mercury_netMgr_InitState();
	      mercury_mesh_forming();
	      mercury_mesh_sendStart();
	  }
    }
}

void diag_verifyRxData(t_rxCvPkt *m)
{
      t_txTokPkt match;

      uint8_t nodeIdx= m->addr-BASE_ADDR; //node indexing should be mapped to array indexing
      t_diag * diag= &NetState.client[nodeIdx].diag;
  
      if(message_dev_searchTX(m,&match)){ // basic token check 
	  //trustFunc(&rxmsg); 
      }
      else
      {
	  mercury_netMgr_transactionUpdate(m->addr, REJECTED);
	  systemStateLog[nodeIdx].currNode = TOKEN_MISMATCH;
	  mercury_netMgr_errorCountUpdate(m->addr,TOKEN_MISMATCH);
      }

      if(crc16Check(m))
	  mercury_netMgr_transactionUpdate(m->addr,ENDED); 
      else{
	  mercury_netMgr_transactionUpdate(m->addr, REJECTED);
	  systemStateLog[nodeIdx].currNode = PEC_FAILED;
	  mercury_netMgr_errorCountUpdate(m->addr,PEC_FAILED);
      }
      NetState.client[nodeIdx].diag.lastUpdated = k_uptime_get_32(); //exported to Radon
}


void diag_fn(void *p1, void *p2, void *p3)
{
	ARG_UNUSED(p1);
	ARG_UNUSED(p2);
	ARG_UNUSED(p3);
	static t_rxCvPkt m; //pointer to received message data
	printk("STARTUP: %d\n",NetState.info.session.startupTs);
	mercury_netMgr_timeoutInit();
	printk("Timeouts init\n");
	while(1){
	      //printk("Thread: diag_fn\n");
	      if(message_dev_fetchRX(&m)!=0) //if we fetched sth (return 1), process it
	      {
		    diag_verifyRxData(&m);
	      }
	      //diag_checkNodePresence(); //used but it is not working as expected. only able to get back into waiting state and reset values
	      //mercury_mesh_reforming(); //inside is a condition that will only allow to enter if system is in BATT_INFO_LOST state
	      //mercury_mesh_checkActiveNodes(); //doesnt do anything
	      k_msleep(DIAG_SLEEP_TIME);
	}
}

void queue_info(struct k_msgq * msgq)
{
      struct k_msgq_attrs attrs;
      k_msgq_get_attrs(msgq,&attrs);
      int curr_size = attrs.used_msgs;
      printk("%d msgs (of size %d [B]) out of %d used.\n",curr_size,attrs.msg_size,attrs.max_msgs);
}

void mercury_main_bms(void *p1, void *p2, void *p3) 
{
	ARG_UNUSED(p1);
	ARG_UNUSED(p2);
	ARG_UNUSED(p3);

	const struct device *dev;
	uint32_t printInt, prevPrint;

	dev = device_get_binding(CONFIG_UART_CONSOLE_ON_DEV_NAME);
	if (dev == NULL) {
		return;
	}
	printk("Sending start\n");
	mercury_mesh_sendStart();//sends start signal for all nodes. implement clock synch in there too
	sessionInfo();
	radon_configInfoTX();

	while(1)
	{
	    printInt = k_uptime_get_32() - prevPrint;
	    //printk(">Thread: main handler\n");
	    radon_latenciesInfoTX();
	    if(printInt>=PRINT_PERIOD){
		//print_data_bucket();
		print_summary();   
		printMeshHealth();
		radon_countersInfoTX();
		prevPrint = k_uptime_get_32();
	    }
	    //printk(">Thread: mercury_main_bms()\n");
	    blink();
	    k_msleep(MAIN_SLEEP_TIME);
	}
}


void mercury_bms_init()
{
    //If BMS, initialise the network management state info
    mercury_netMgr_InitState();//NetState passed as a global extern 
}

#endif
```

## src/app_master.h
```c
#ifndef APP_MASTER_H //define app_master only once
#define APP_MASTER_H

#include <zephyr.h>
#include <app_memory/app_memdomain.h>
#include <sys/sys_heap.h>
#include <sys/crc.h>


#include <sys/libc-hooks.h>
#include <syscall_handler.h>

#include "hg_netMgr.h"

#define STACK_SIZE 1024
//TX PRIO- -9, RX PRIO- -8
//#define LISTEN_THREAD_PRIO (K_PRIO_COOP(CONFIG_BT_RX_PRIO)+1)//-6, cooperative priorities.Lower thread numbers have higher priority values, e.g. thread 0 will be preempted only by the listen thread
#define DIAG_THREAD_PRIO (K_PRIO_COOP(CONFIG_BT_RX_PRIO)+1)  //-7
#define MAIN_THREAD_PRIO (DIAG_THREAD_PRIO+1) //preemptive


/*
listen = -7 (highest coop here), diag= -6 
main = 1 

RX data -(resume listen)->Listen->(suspend listen)->Diag-(diag sleep)-> main-(main sleep)->Diag..
currently:
8 diags / 1 main

*/

#define DIAG_SLEEP_TIME 10
#define MAIN_SLEEP_TIME 5
#define PRINT_PERIOD 5000

//void listen_fn(void *p1, void *p2, void *p3);
void mercury_main_bms(void *p1, void *p2, void *p3) ;
void diag_fn(void *p1, void *p2, void *p3);

//void mercury_resume_listen();
void mercury_bms_init();

#endif
```

## src/app_slave.c
```c
#include "buildcfg.h"

#if NODETYPE == NODETYPE_CMB

#include "app_slave.h"
#include "hg_mesh.h"
#include "hg_netMgr.h"

#include "hg_spi.h"
#include "hg_ltc.h"

hgNetClient NetCli;
struct k_sem startSem;
struct k_sem ack;
uint8_t okSgn;
uint8_t rcvSgn;
uint8_t restartSgn;
extern t_logCmb cmbInfo;
extern hgLTC_State cmbData;
t_tx newPkt; 
uint16_t currCrc;

void mercury_main_cmb(void *p1, void *p2, void *p3);
void polling_fn(void *p1, void *p2, void *p3);

K_MUTEX_DEFINE(pktMutex);
K_SEM_DEFINE(pollSem,1,1);

void blink()
{
	mercury_led_flash(50);
	k_msleep(50);
	mercury_led_flash(50);
	k_msleep(50);
}

void mercury_wakeup_main_cmb(){

}

void calcCrc(){
    currCrc = crc16_ansi(cmbData.cellVolts,LTC_NCELLS);
    //printk("PEC: %d\n", currCrc);
}

void mercury_acquire_nodeAddress(){
      bool flag_done = false;
      //Wait for the BMS to give us an address on the network
      while (mercury_mesh_getMeshAddr() == NODE_CMB_DEFADDR) {
	      mercury_mesh_requestAddress();
	      //printk("Sent addr rq\n");
	
	      uint32_t t0 = k_uptime_get_32();
	
	      while (k_uptime_get_32() - t0 < 2000) { //waits 2sec for new address
		      if (mercury_mesh_getMeshAddr() != NODE_CMB_DEFADDR) {
			      flag_done = true;
			      break;
		      }
		
		      k_msleep(10);
	      }
	
	      if (flag_done) {
		      break;
	      }
      }
      printk("Finished aquiring an address. CMB is now at addr=%d\n", mercury_mesh_getMeshAddr());
}

void mercury_cmb_init()
{
//CMBs need a working SPI bus for talking to the LTC
      mercury_spi_setup(14, 13, 12, SPI_Speed_250K);
      k_msleep(500);

      //Bring up the LTC
      int8_t LTCInitCode = mercury_ltc_init();
	if (LTCInitCode != 0) {
	      printk("Error initialising LTC code=%d!\n", LTCInitCode);
      }
}


void polling_fn(void *p1, void *p2, void *p3) {

	ARG_UNUSED(p1);
	ARG_UNUSED(p2);
	ARG_UNUSED(p3);

	while(1){
	    //printk(">Thread: polling()\n");
	  k_sem_take(&pollSem,K_FOREVER);
	  poll_fake_cv();
	  calcCrc();
	  k_sem_give(&pollSem);
	  blink(); 
	  k_msleep(POLLING_INT);
	}
}

void mercury_main_cmb(void *p1, void *p2, void *p3) 
{
	ARG_UNUSED(p1);
	ARG_UNUSED(p2);
	ARG_UNUSED(p3);

	k_sem_init(&startSem, 0, 1);
	k_sem_init(&ack, 0, 1);
	k_sem_take(&startSem,K_FOREVER);
	printk("Starting main..\n");
	mercury_netMgr_sendOK(NODE_BMS_ADDR);
	okSgn=0;
	rcvSgn=0;
	restartSgn =0;
	while(1){
		//printk(">Thread: mercury_main_cmb()\n");
		if(okSgn || rcvSgn || restartSgn){//if ACK or RECOVERY was received
		    mercury_netMgr_sendOK(NODE_BMS_ADDR);
		    okSgn= 0;
		    rcvSgn=0;
		    restartSgn=0; //if restart was received
		}
		k_msleep(OK_STATUS_INTERVAL_MS);
	}
}

#endif
```

## src/app_slave.h
```c
#ifndef APP_SLAVE_H //define app_slave only once
#define APP_SLAVE_H

#include <zephyr.h>
#include <random/rand32.h>
#include <app_memory/app_memdomain.h>
#include <sys/libc-hooks.h>
#include <syscall_handler.h>
#include <sys/crc.h> //cmb

#define CMB_SLEEP_TIME 10
#define STACK_SIZE 1024
#define POLLING_INT 100

#define MAIN_THREAD_PRIO 0//-7
#define POLL_THREAD_PRIO 1

void mercury_wakeup_main_cmb();
void mercury_cmb_init();
void mercury_acquire_nodeAddress();

void mercury_main_cmb(void *p1, void *p2, void *p3);
void polling_fn(void *p1, void *p2, void *p3);

#endif
```

## src/buildcfg_bms.h
```c
#include "buildcfg_common.h"

#define NODETYPE NODETYPE_BMS
```

## src/buildcfg_cmb.h
```c
#include "buildcfg_common.h"

#define NODETYPE NODETYPE_CMB
```

## src/buildcfg_common.h
```c
#define MESH_NODEID_CMB 0x10

//Constants to differentiate between CMB and BMS builds
#define NODETYPE_BMS	 0xDEADF00D
#define NODETYPE_CMB	 0xFEEDBEEF

#define NODE_BMS_ADDR	 0xE0 //224
#define NODE_CMB_DEFADDR 0x01 
```

## src/fnv.c
```c
/*
 * fnv - Fowler/Noll/Vo- hash code
 *
 * The basis of this hash algorithm was taken from an idea sent
 * as reviewer comments to the IEEE POSIX P1003.2 committee by:
 *
 *      Phong Vo (http://www.research.att.com/info/kpv/)
 *      Glenn Fowler (http://www.research.att.com/~gsf/)
 *
 * In a subsequent ballot round:
 *
 *      Landon Curt Noll (http://www.isthe.com/chongo/)
 *
 * improved on their algorithm.  Some people tried this hash
 * and found that it worked rather well.  In an EMail message
 * to Landon, they named it the ``Fowler/Noll/Vo'' or FNV hash.
 *
 * FNV hashes are designed to be fast while maintaining a low
 * collision rate. The FNV speed allows one to quickly hash lots
 * of data while maintaining a reasonable collision rate.  See:
 *
 *      http://www.isthe.com/chongo/tech/comp/fnv/index.html
 *
 * for more details as well as other forms of the FNV hash.
 *
 ***
 *
 * To use the recommended 32 bit FNV-1 hash, pass FNV1_32_INIT as the
 * Fnv32_t hashval argument to fnv_32_buf() or fnv_32_str().
 *
 * To use the recommended 64 bit FNV-1 hash, pass FNV1_64_INIT as the
 * Fnv64_t hashval argument to fnv_64_buf() or fnv_64_str().
 *
 * To use the recommended 32 bit FNV-1a hash, pass FNV1_32A_INIT as the
 * Fnv32_t hashval argument to fnv_32a_buf() or fnv_32a_str().
 *
 * To use the recommended 64 bit FNV-1a hash, pass FNV1A_64_INIT as the
 * Fnv64_t hashval argument to fnv_64a_buf() or fnv_64a_str().
 *
 ***
 *
 * Please do not copyright this code.  This code is in the public domain.
 *
 * LANDON CURT NOLL DISCLAIMS ALL WARRANTIES WITH REGARD TO THIS SOFTWARE,
 * INCLUDING ALL IMPLIED WARRANTIES OF MERCHANTABILITY AND FITNESS. IN NO
 * EVENT SHALL LANDON CURT NOLL BE LIABLE FOR ANY SPECIAL, INDIRECT OR
 * CONSEQUENTIAL DAMAGES OR ANY DAMAGES WHATSOEVER RESULTING FROM LOSS OF
 * USE, DATA OR PROFITS, WHETHER IN AN ACTION OF CONTRACT, NEGLIGENCE OR
 * OTHER TORTIOUS ACTION, ARISING OUT OF OR IN CONNECTION WITH THE USE OR
 * PERFORMANCE OF THIS SOFTWARE.
 *
 * By:
 *	chongo <Landon Curt Noll> /\oo/\
 *      http://www.isthe.com/chongo/
 *
 * Share and Enjoy!	:-)
 */

#include <stdlib.h>
#include "fnv.h"
#include "stdio.h"

/*
 * 32 bit magic FNV-0 and FNV-1 prime
 */
#define FNV_32_PRIME ((Fnv32_t)0x01000193)

volatile uint32_t prev_timestamp = 0;

/*
 * fnv_32_buf - perform a 32 bit Fowler/Noll/Vo hash on a buffer
 *
 * input:
 *	buf	- start of buffer to hash
 *	len	- length of buffer in octets
 *	hval	- previous hash value or 0 if first call
 *
 * returns:
 *	32 bit hash as a static hash type
 *
 * NOTE: To use the 32 bit FNV-0 historic hash, use FNV0_32_INIT as the hval
 *	 argument on the first call to either fnv_32_buf() or fnv_32_str().
 *
 * NOTE: To use the recommended 32 bit FNV-1 hash, use FNV1_32_INIT as the hval
 *	 argument on the first call to either fnv_32_buf() or fnv_32_str().
 */
Fnv32_t fnv_32_buf(void *buf, size_t len, Fnv32_t hval)
{
	unsigned char *bp = (unsigned char *)buf; /* start of buffer */
	unsigned char *be = bp + len;			  /* beyond end of buffer */

	/*
     * FNV-1 hash each octet in the buffer
     */
	while (bp < be) {
		/* multiply by the 32 bit FNV magic prime mod 2^32 */
#if defined(NO_FNV_GCC_OPTIMIZATION)
		hval *= FNV_32_PRIME;
#else
		hval += (hval << 1) + (hval << 4) + (hval << 7) + (hval << 8) + (hval << 24);
#endif

		/* xor the bottom with the current octet */
		hval ^= (Fnv32_t)*bp++;
	}

	/* return our new hash value */
	return hval;
}

/*
 * fnv_32_str - perform a 32 bit Fowler/Noll/Vo hash on a string
 *
 * input:
 *	str	- string to hash
 *	hval	- previous hash value or 0 if first call
 *
 * returns:
 *	32 bit hash as a static hash type
 *
 * NOTE: To use the 32 bit FNV-0 historic hash, use FNV0_32_INIT as the hval
 *	 argument on the first call to either fnv_32_buf() or fnv_32_str().
 *
 * NOTE: To use the recommended 32 bit FNV-1 hash, use FNV1_32_INIT as the hval
 *	 argument on the first call to either fnv_32_buf() or fnv_32_str().
 */
Fnv32_t fnv_32_str(char *str, Fnv32_t hval)
{
	unsigned char *s = (unsigned char *)str; /* unsigned string */

	/*
     * FNV-1 hash each octet in the buffer
     */
	while (*s) {
		/* multiply by the 32 bit FNV magic prime mod 2^32 */
#if defined(NO_FNV_GCC_OPTIMIZATION)
		hval *= FNV_32_PRIME;
#else
		hval += (hval << 1) + (hval << 4) + (hval << 7) + (hval << 8) + (hval << 24);
#endif

		/* xor the bottom with the current octet */
		hval ^= (Fnv32_t)*s++;
	}

	/* return our new hash value */
	return hval;
}

/*
 * fnv_32a_buf - perform a 32 bit Fowler/Noll/Vo FNV-1a hash on a buffer
 *
 * input:
 *	buf	- start of buffer to hash
 *	len	- length of buffer in octets
 *	hval	- previous hash value or 0 if first call
 *
 * returns:
 *	32 bit hash as a static hash type
 *
 * NOTE: To use the recommended 32 bit FNV-1a hash, use FNV1_32A_INIT as the
 * 	 hval arg on the first call to either fnv_32a_buf() or fnv_32a_str().
 */
Fnv32_t fnv_32a_buf(void *buf, size_t len, Fnv32_t hval)
{
	unsigned char *bp = (unsigned char *)buf; /* start of buffer */
	unsigned char *be = bp + len;			  /* beyond end of buffer */

	/*
     * FNV-1a hash each octet in the buffer
     */
	while (bp < be) {
		/* xor the bottom with the current octet */
		hval ^= (Fnv32_t)*bp++;

		/* multiply by the 32 bit FNV magic prime mod 2^32 */
#if defined(NO_FNV_GCC_OPTIMIZATION)
		hval *= FNV_32_PRIME;
#else
		hval += (hval << 1) + (hval << 4) + (hval << 7) + (hval << 8) + (hval << 24);
#endif
	}

	/* return our new hash value */
	return hval;
}

/*
 * fnv_32a_str - perform a 32 bit Fowler/Noll/Vo FNV-1a hash on a string
 *
 * input:
 *	str	- string to hash
 *	hval	- previous hash value or 0 if first call
 *
 * returns:
 *	32 bit hash as a static hash type
 *
 * NOTE: To use the recommended 32 bit FNV-1a hash, use FNV1_32A_INIT as the
 *  	 hval arg on the first call to either fnv_32a_buf() or fnv_32a_str().
 */
Fnv32_t fnv_32a_str(char *str, Fnv32_t hval)
{
	unsigned char *s = (unsigned char *)str; /* unsigned string */

	/*
     * FNV-1a hash each octet in the buffer
     */
	while (*s) {
		/* xor the bottom with the current octet */
		hval ^= (Fnv32_t)*s++;

		/* multiply by the 32 bit FNV magic prime mod 2^32 */
#if defined(NO_FNV_GCC_OPTIMIZATION)
		hval *= FNV_32_PRIME;
#else
		hval += (hval << 1) + (hval << 4) + (hval << 7) + (hval << 8) + (hval << 24);
#endif
	}

	/* return our new hash value */
	return hval;
}

/*
 * 64 bit magic FNV-0 and FNV-1 prime
 */
#define FNV_64_PRIME ((Fnv64_t)0x100000001b3ULL)

/*
 * fnv_64_buf - perform a 64 bit Fowler/Noll/Vo hash on a buffer
 *
 * input:
 *	buf	- start of buffer to hash
 *	len	- length of buffer in octets
 *	hval	- previous hash value or 0 if first call
 *
 * returns:
 *	64 bit hash as a static hash type
 *
 * NOTE: To use the 64 bit FNV-0 historic hash, use FNV0_64_INIT as the hval
 *	 argument on the first call to either fnv_64_buf() or fnv_64_str().
 *
 * NOTE: To use the recommended 64 bit FNV-1 hash, use FNV1_64_INIT as the hval
 *	 argument on the first call to either fnv_64_buf() or fnv_64_str().
 */
Fnv64_t fnv_64_buf(void *buf, size_t len, Fnv64_t hval)
{
	unsigned char *bp = (unsigned char *)buf; /* start of buffer */
	unsigned char *be = bp + len;			  /* beyond end of buffer */

	/*
     * FNV-1 hash each octet of the buffer
     */
	while (bp < be) {
		/* multiply by the 64 bit FNV magic prime mod 2^64 */
#if defined(NO_FNV_GCC_OPTIMIZATION)
		hval *= FNV_64_PRIME;
#else  /* NO_FNV_GCC_OPTIMIZATION */
		hval += (hval << 1) + (hval << 4) + (hval << 5) + (hval << 7) + (hval << 8) + (hval << 40);
#endif /* NO_FNV_GCC_OPTIMIZATION */

		/* xor the bottom with the current octet */
		hval ^= (Fnv64_t)*bp++;
	}

	/* return our new hash value */
	return hval;
}

/*
 * fnv_64_str - perform a 64 bit Fowler/Noll/Vo hash on a buffer
 *
 * input:
 *	buf	- start of buffer to hash
 *	hval	- previous hash value or 0 if first call
 *
 * returns:
 *	64 bit hash as a static hash type
 *
 * NOTE: To use the 64 bit FNV-0 historic hash, use FNV0_64_INIT as the hval
 *	 argument on the first call to either fnv_64_buf() or fnv_64_str().
 *
 * NOTE: To use the recommended 64 bit FNV-1 hash, use FNV1_64_INIT as the hval
 *	 argument on the first call to either fnv_64_buf() or fnv_64_str().
 */
Fnv64_t fnv_64_str(char *str, Fnv64_t hval)
{
	unsigned char *s = (unsigned char *)str; /* unsigned string */

	/*
     * FNV-1 hash each octet of the string
     */
	while (*s) {
		/* multiply by the 64 bit FNV magic prime mod 2^64 */
#if defined(NO_FNV_GCC_OPTIMIZATION)
		hval *= FNV_64_PRIME;
#else  /* NO_FNV_GCC_OPTIMIZATION */
		hval += (hval << 1) + (hval << 4) + (hval << 5) + (hval << 7) + (hval << 8) + (hval << 40);
#endif /* NO_FNV_GCC_OPTIMIZATION */

		/* xor the bottom with the current octet */
		hval ^= (Fnv64_t)*s++;
	}

	/* return our new hash value */
	return hval;
}

/*
 * fnv_64a_buf - perform a 64 bit Fowler/Noll/Vo FNV-1a hash on a buffer
 *
 * input:
 *	buf	- start of buffer to hash
 *	len	- length of buffer in octets
 *	hval	- previous hash value or 0 if first call
 *
 * returns:
 *	64 bit hash as a static hash type
 *
 * NOTE: To use the recommended 64 bit FNV-1a hash, use FNV1A_64_INIT as the
 * 	 hval arg on the first call to either fnv_64a_buf() or fnv_64a_str().
 */
Fnv64_t fnv_64a_buf(void *buf, size_t len, Fnv64_t hval)
{
	unsigned char *bp = (unsigned char *)buf; /* start of buffer */
	unsigned char *be = bp + len;			  /* beyond end of buffer */

	/*
     * FNV-1a hash each octet of the buffer
     */
	while (bp < be) {
		/* xor the bottom with the current octet */
		hval ^= (Fnv64_t)*bp++;

		/* multiply by the 64 bit FNV magic prime mod 2^64 */
#if defined(NO_FNV_GCC_OPTIMIZATION)
		hval *= FNV_64_PRIME;
#else  /* NO_FNV_GCC_OPTIMIZATION */
		hval += (hval << 1) + (hval << 4) + (hval << 5) + (hval << 7) + (hval << 8) + (hval << 40);
#endif /* NO_FNV_GCC_OPTIMIZATION */
	}

	/* return our new hash value */
	return hval;
}

/*
 * fnv_64a_str - perform a 64 bit Fowler/Noll/Vo FNV-1a hash on a buffer
 *
 * input:
 *	buf	- start of buffer to hash
 *	hval	- previous hash value or 0 if first call
 *
 * returns:
 *	64 bit hash as a static hash type
 *
 * NOTE: To use the recommended 64 bit FNV-1a hash, use FNV1A_64_INIT as the
 * 	 hval arg on the first call to either fnv_64a_buf() or fnv_64a_str().
 */
Fnv64_t fnv_64a_str(char *str, Fnv64_t hval)
{
	unsigned char *s = (unsigned char *)str; /* unsigned string */

	/*
     * FNV-1a hash each octet of the string
     */
	while (*s) {
		/* xor the bottom with the current octet */
		hval ^= (Fnv64_t)*s++;

		/* multiply by the 64 bit FNV magic prime mod 2^64 */
#if defined(NO_FNV_GCC_OPTIMIZATION)
		hval *= FNV_64_PRIME;
#else  /* NO_FNV_GCC_OPTIMIZATION */
		hval += (hval << 1) + (hval << 4) + (hval << 5) + (hval << 7) + (hval << 8) + (hval << 40);
#endif /* NO_FNV_GCC_OPTIMIZATION */
	}

	/* return our new hash value */
	return hval;
}

uint32_t token_gen(uint32_t get_timestamp)
{
	char	 toHash[32];
	uint32_t Hash_32;
	//uint32_t get_timestamp = prev_timestamp;
	//while (get_timestamp == prev_timestamp) {
	//	get_timestamp = k_cycle_get_32();
	//}
	//prev_timestamp = get_timestamp;
	sprintf(toHash, "%lu", get_timestamp);
	Hash_32 = fnv_32a_str(toHash, FNV1_32A_INIT);
	return Hash_32;
}
```

## src/fnv.h
```c
/*
 * fnv - Fowler/Noll/Vo- hash code
 *
 * The basis of this hash algorithm was taken from an idea sent
 * as reviewer comments to the IEEE POSIX P1003.2 committee by:
 *
 *      Phong Vo (http://www.research.att.com/info/kpv/)
 *      Glenn Fowler (http://www.research.att.com/~gsf/)
 *
 * In a subsequent ballot round:
 *
 *      Landon Curt Noll (http://www.isthe.com/chongo/)
 *
 * improved on their algorithm.  Some people tried this hash
 * and found that it worked rather well.  In an EMail message
 * to Landon, they named it the ``Fowler/Noll/Vo'' or FNV hash.
 *
 * FNV hashes are designed to be fast while maintaining a low
 * collision rate. The FNV speed allows one to quickly hash lots
 * of data while maintaining a reasonable collision rate.  See:
 *
 *      http://www.isthe.com/chongo/tech/comp/fnv/index.html
 *
 * for more details as well as other forms of the FNV hash.
 *
 ***
 *
 * To use the recommended 32 bit FNV-1 hash, pass FNV1_32_INIT as the
 * Fnv32_t hashval argument to fnv_32_buf() or fnv_32_str().
 *
 * To use the recommended 64 bit FNV-1 hash, pass FNV1_64_INIT as the
 * Fnv64_t hashval argument to fnv_64_buf() or fnv_64_str().
 *
 * To use the recommended 32 bit FNV-1a hash, pass FNV1_32A_INIT as the
 * Fnv32_t hashval argument to fnv_32a_buf() or fnv_32a_str().
 *
 * To use the recommended 64 bit FNV-1a hash, pass FNV1A_64_INIT as the
 * Fnv64_t hashval argument to fnv_64a_buf() or fnv_64a_str().
 *
 ***
 *
 * Please do not copyright this code.  This code is in the public domain.
 *
 * LANDON CURT NOLL DISCLAIMS ALL WARRANTIES WITH REGARD TO THIS SOFTWARE,
 * INCLUDING ALL IMPLIED WARRANTIES OF MERCHANTABILITY AND FITNESS. IN NO
 * EVENT SHALL LANDON CURT NOLL BE LIABLE FOR ANY SPECIAL, INDIRECT OR
 * CONSEQUENTIAL DAMAGES OR ANY DAMAGES WHATSOEVER RESULTING FROM LOSS OF
 * USE, DATA OR PROFITS, WHETHER IN AN ACTION OF CONTRACT, NEGLIGENCE OR
 * OTHER TORTIOUS ACTION, ARISING OUT OF OR IN CONNECTION WITH THE USE OR
 * PERFORMANCE OF THIS SOFTWARE.
 *
 * By:
 *	chongo <Landon Curt Noll> /\oo/\
 *      http://www.isthe.com/chongo/
 *
 * Share and Enjoy!	:-)
 */

#if !defined(__FNV_H__)
#define __FNV_H__

#include <zephyr.h>

#define FNV_VERSION "5.0.2" /* @(#) FNV Version */

typedef uint32_t Fnv32_t;

/*
 * 32 bit FNV-1 and FNV-1a non-zero initial basis
 * NOTE: The FNV-1a initial basis is the same value as FNV-1 by definition.
 */
#define FNV1_32_INIT  ((Fnv32_t)0x811c9dc5)
#define FNV1_32A_INIT FNV1_32_INIT

extern Fnv32_t fnv_32_buf(void *buf, size_t len, Fnv32_t hashval);
extern Fnv32_t fnv_32_str(char *buf, Fnv32_t hashval);

extern Fnv32_t fnv_32a_buf(void *buf, size_t len, Fnv32_t hashval);
extern Fnv32_t fnv_32a_str(char *buf, Fnv32_t hashval);

typedef uint64_t Fnv64_t;

/*
 * 64 bit FNV-1 non-zero initial basis
 * NOTE: The FNV-1a initial basis is the same value as FNV-1 by definition.
 */
#define FNV1_64_INIT  ((Fnv64_t)0xcbf29ce484222325ULL)
#define FNV1A_64_INIT FNV1_64_INIT

extern Fnv64_t fnv_64_buf(void *buf, size_t len, Fnv64_t hashval);
extern Fnv64_t fnv_64_str(char *buf, Fnv64_t hashval);

extern Fnv64_t fnv_64a_buf(void *buf, size_t len, Fnv64_t hashval);
extern Fnv64_t fnv_64a_str(char *buf, Fnv64_t hashval);

uint32_t token_gen(uint32_t get_timestamp);

#endif /* __FNV_H__ */
```

## src/fwupd.c
```c
//Headers for the bootloader funzies
#include <string.h>
#include <sys/printk.h>
#include <stdlib.h>
#include <drivers/uart.h>
#include <power/reboot.h>
#include <drivers/flash.h>
#include <storage/flash_map.h>

#include "led.h"

#define UART_DEVICE_NAME  CONFIG_UART_CONSOLE_ON_DEV_NAME

#define FWUPD_STAGING_POS 0x40000
#define FWUPD_SIZE_POS	  0x7FFFC

/*
 * Final stage of the update process, copy the update file back to main memory
 */

#define cfgRegister	  *((volatile uint32_t *)(0x4001E000 + 0x504))
#define eraseRegister *((volatile uint32_t *)(0x4001E000 + 0x508))
#define readyRegister *((volatile uint32_t *)(0x4001E000 + 0x400))

#define aircrRegister *((volatile uint32_t *)(0xE000EDC))

void mercury_fwupd_stageF()
{
	mercury_led_done(2);

	//Erase the flash to allow for writing of the downloaded update
	uint32_t baseAddr = 0;
	for (uint32_t z = 0; z < 64; z++) {
		cfgRegister = 2;
		while (readyRegister == 0) {
		}

		eraseRegister = baseAddr;
		baseAddr += 0x1000;
		while (readyRegister == 0) {
		}
	}

	volatile uint32_t *sourceAddr = (uint32_t *)FWUPD_STAGING_POS;
	volatile uint32_t *destAddr	  = (uint32_t *)0;
	uint32_t		   pos		  = 0x0000;
	while (pos < 0x3FFFF) {
		cfgRegister = 1;
		while (readyRegister == 0) {
		}

		*destAddr = *sourceAddr;

		while (readyRegister == 0) {
		}

		destAddr += 1;
		sourceAddr += 1;
	}

	//TODO: This should reset the chip but doesnt. Needs investigated.
	aircrRegister = (0x5FA << 16) | (1 << 2);
}

void mercury_fwupd_entryPoint()
{
	//obtain flash device to write to
	const struct device *flash_dev = device_get_binding("NRF_FLASH_DRV_NAME");

	if (!flash_dev) {
		mercury_led_fatal(3);

		return;
	}

	const struct device *uart_dev = device_get_binding(UART_DEVICE_NAME);

	if (!uart_dev) {
		mercury_led_fatal(4);

		return;
	}

	printk("ready\n");

	mercury_led_done(1);

	const uint8_t maxBSize = 240;
	uint8_t		  bufData[maxBSize], block2[maxBSize];
	int16_t		  buffPos	  = 0;
	int8_t		  payloadSize = 0;
	uint8_t		  mType		  = 0;
	uint8_t		  cIn;
	uint32_t	  baseAddr = 0;

	//Erase the memory where the update firmware will be stored
	{
		struct flash_pages_info info;

		for (int z = 64; z < 128; z++) {
			flash_get_page_info_by_idx(flash_dev, z, &info);

			if (flash_erase(flash_dev, info.start_offset, info.size) != 0) {
				mercury_led_fatal(6);

				return;
			}
		}
	}

	bool ledState = false;
	//Download the firmware to FWUPD_STAGING_POS from mflash
	while (true) {
		//Receive message type
		while (uart_poll_in(uart_dev, &mType) != 0) {
		}
		uart_poll_out(uart_dev, mType);

		//All data payloads are type 0, anything else and we are done with data
		if (mType != 0) {
			break;
		}

		//Receive base address
		buffPos = 0;
		while (buffPos < 4) {
			if (uart_poll_in(uart_dev, &cIn) == 0) {
				bufData[buffPos] = cIn;
				buffPos += 1;
				uart_poll_out(uart_dev, cIn);
			}
		}

		baseAddr = bufData[0] + (256 * bufData[1]) + (256 * 256 * bufData[2]) + (256 * 256 * 256 * bufData[3]);

		//Receive payload size
		while (uart_poll_in(uart_dev, &payloadSize) != 0) {
		}
		uart_poll_out(uart_dev, payloadSize);

		buffPos = 0;
		while (buffPos < payloadSize) {
			if (uart_poll_in(uart_dev, &cIn) == 0) {
				bufData[buffPos] = cIn;

				buffPos += 1;
				uart_poll_out(uart_dev, cIn);
			}
		}

		flash_write(flash_dev, FWUPD_STAGING_POS + baseAddr, bufData, payloadSize);
		flash_read(flash_dev, FWUPD_STAGING_POS + baseAddr, block2, payloadSize);

		bool egal = true;
		for (int z = 0; z < payloadSize; z++) {
			if (block2[z] != bufData[z]) {
				egal = false;

				//If this executes we have a problem with corrupted flash, go into failure mode 3
				mercury_led_fatal(3);
			}
		}

		//printk("%x s=%d [%2X %2X %2X %2X %2X %2X %2X %2X] %d \n",baseAddr+FWUPD_STAGING_POS, payloadSize, bufData[0],bufData[1],bufData[2],bufData[3],bufData[4],bufData[5],bufData[6],bufData[7], egal);

		//Flash LED for 1ms on each block to indicate things are happening
		ledState = !ledState;
		mercury_led_setState(ledState);
	}

	mercury_led_done(2);
	mercury_fwupd_stageF();
}
```

## src/hg_ltc.c
```c
#include "hg_ltc.h"
#include "ltc_cmd.h"
#include <random/rand32.h>

//-----------STUBS----

 hgLTC_State cmbData;

void poll_fake_cv(){  
    for(int i=0;i<LTC_NCELLS;i++){
	  sys_rand_get(&cmbData.cellVolts[i],8*CV_SIZE); //8 bit value
	  //printk("LTC: %d, \n",cmbData.cellVolts[i]);
    } 
    //printk("\n");
}

//-------------------

void ltc_startadc();
void ltc_convadc();
void ltc_readcv(hgLTC_State *state);

uint16_t mercury_ltc_calcPEC(uint8_t  len, //Number of bytes that will be used to calculate a PEC
							 uint8_t *data //Array of data that will be used to calculate  a PEC
)
{
	uint16_t remainder, addr;
	remainder = 16; //initialize the PEC

	for (uint8_t i = 0; i < len; i++) // loops for each byte in data array
	{
		addr	  = ((remainder >> 7) ^ data[i]) & 0xff; //calculate PEC table address
		remainder = (remainder << 8) ^ crc15Table[addr];
	}

	return (remainder * 2); //The CRC15 has a 0 in the LSB so the remainder must be multiplied by 2
}

void mercury_ltc_csLow()
{
	gpio_pin_set(LTC_CS_PIN_DEV, LTC_CS_PIN, 0);
}

void mercury_ltc_csHigh()
{
	gpio_pin_set(LTC_CS_PIN_DEV, LTC_CS_PIN, 1);
}

void mercury_ltc_wakeIdle()
{
	mercury_ltc_csLow();

	{
		uint8_t wData, rData;

		wData = 0xff;
		mercury_spi_read_seq(&wData, 1, &rData, 1);
	}

	mercury_ltc_csHigh();
}

void mercury_ltc_wakeSleep()
{
	mercury_ltc_csLow();
	k_usleep(300);
	mercury_ltc_csHigh();
	k_usleep(10);
}
/*!**********************************************************************
 \brief  Initializes hardware and variables
  @return void
 ***********************************************************************/
int16_t mercury_ltc_init()
{
	//Set up CS pin for output
	gpio_pin_configure(LTC_CS_PIN_DEV, LTC_CS_PIN, GPIO_OUTPUT);
	gpio_pin_set(LTC_CS_PIN_DEV, LTC_CS_PIN, 1);

	mercury_ltc_wakeSleep();

	//Send init command streams. ref p.66 of ltc 6812 spec
	{
		//Set config bits CFGRA to: REFON,ADCOPT,GPIOBITS_A,DCCBITS_A, DCTOBITS, UV, OV, PEC0, PEC1
		uint8_t CMDStream_WCfgA[12] = { 0x0, 0x1, 0x3D, 0x6E, 0xE4, 0x52, 0x27, 0xA0, 0x0, 0x50, 0x47, 0x48 };
		// Set config bits CFGRB to: FDRF,DTMEN,PSBits,GPIOBITS_B,DCCBITS_B, PEC0, PEC1
		uint8_t CMDStream_WCfgB[12] = { 0x0, 0x24, 0xB1, 0x9E, 0x0, 0x8, 0x0, 0x0, 0x0, 0x0, 0x90, 0x5A };
		//write CMDStream_WCfgA on spi
		mercury_ltc_csLow();
		mercury_spi_write(CMDStream_WCfgA, sizeof(CMDStream_WCfgA));
		mercury_ltc_csHigh();
		//write CMDStream_WCfgB on spi
		mercury_ltc_csLow();
		mercury_spi_write(CMDStream_WCfgB, sizeof(CMDStream_WCfgB));
		mercury_ltc_csHigh();
	}

	mercury_ltc_wakeIdle();

	//Read back the config data
	uint8_t CMDStream_RCfgA[4] = { 0x0, 0x2, 0x2B, 0xA };
	uint8_t CMDBuffer_RCfgA[8];

	uint8_t CMDStream_RCfgB[4] = { 0x0, 0x26, 0x2C, 0xC8 };
	uint8_t CMDBuffer_RCfgB[8];

	mercury_ltc_csLow();
	mercury_spi_read_seq(CMDStream_RCfgA, sizeof(CMDStream_RCfgA), CMDBuffer_RCfgA, 8);
	mercury_ltc_csHigh();
	mercury_ltc_csLow();
	mercury_spi_read_seq(CMDStream_RCfgB, sizeof(CMDStream_RCfgB), CMDBuffer_RCfgB, 8);
	mercury_ltc_csHigh();
	//Calculate PEC of returned data
	uint16_t pecA = mercury_ltc_calcPEC(6, CMDBuffer_RCfgA);
	uint16_t pecB = mercury_ltc_calcPEC(6, CMDBuffer_RCfgB);

	uint16_t pecARef = (0x47 << 8) | 0x48;
	uint16_t pecBRef = (0x90 << 8) | 0x5A;

	int8_t retCode = 0;

	if (pecA != pecARef) {
		retCode -= 1;
	}

	if (pecB != pecBRef) {
		retCode -= 10;
	}


	return retCode;

	/*
	S0xE4, 0x52, 0x27, 0xA0, 0x00, 0x50}
	0x00, 0x08, 0x00, 0x00, 0x00, 0x00}
     */
}


int16_t mercury_ltc_updateState(hgLTC_State *state)
{
	if (state == NULL) {
		return -1;
	}

		ltc_convadc();//poll adc- method 2 ref ltc spec
		ltc_readcv(state);//Read the voltage data


	return 0;
}

/* Starts ADC conversion for cell voltage */
void ltc_startadc(){
  uint8_t md_bits;
  uint8_t cmd[4];//conversion command
  uint16_t cmd_pec;

  //see p. 60 & 61 from ltc6812 spec
  md_bits = (LTC6812_ADC_MD & 0x02) >> 1;
  cmd[0] = md_bits + 0x02;
  md_bits = (LTC6812_ADC_MD & 0x01) << 7;
  cmd[1] =  md_bits + 0x60 + (LTC6812_ADC_DCP<<4) + LTC6812_NUM_ADCCH;
  //cmd should be 0x360 for current setting !!

  cmd_pec = mercury_ltc_calcPEC(2, cmd); //should take only first two bytes. for this config: cmd- 0x0360
  cmd[2] = (uint8_t)(cmd_pec >> 8);
  cmd[3] = (uint8_t)(cmd_pec);
  //printk("startadc; %x%x\n",cmd[0],cmd[1]);

  mercury_ltc_wakeSleep();

  //Tell Ltc to start sampling the cell voltages
  mercury_ltc_csLow();
  mercury_spi_write(cmd, 4);
  mercury_ltc_csHigh();
}



// Start Cell ADC Measurement and wait for finish
/* This function will block operation until the ADC has finished it's conversion- see for loop*/
void ltc_convadc(){

    uint32_t iter	   = 0;
    uint32_t	 convTime  = 0;
    uint8_t	 currentTimeByteTx = 0xff;
    uint8_t	 currentTimeByteRx = 0;
    bool	 pollOkay  = false;
    uint8_t cmd[4];
    uint16_t cmd_pec;

    //init and start conversion adc
  ltc_startadc();

    cmd[0] |= (LTC6812_PLADC>> 8); //0x07
    cmd[1] |= (LTC6812_PLADC);  //0x14

    cmd_pec = mercury_ltc_calcPEC(2, cmd);
    cmd[2] = (uint8_t)(cmd_pec >> 8);
    cmd[3] = (uint8_t)(cmd_pec);

    //printk("convadc; %x%x\n",cmd[0],cmd[1]);

		//Poll the ADC for done status
		mercury_spi_write(cmd, 4);
		//hold CSB low after an ADC conversion command is sent.
		mercury_ltc_csLow();

		/*After entering the PLADC command, SDO will go low if
the device is busy performing conversions.*/
		while (iter < 20000) {
      //reading means writing 0xFF on the SDO to pull down this line
			mercury_spi_read_seq(&currentTimeByteTx, 1, &currentTimeByteRx, 1);
      //end condition- returns positive time value on completion of adc conversion- see polling method 2
			if (currentTimeByteRx > 0) {
				pollOkay = true;
				break;
			} else {
				iter += 1;
			}
		}
		mercury_ltc_csHigh();

		// if (!pollOkay) {
		// 	return -2;
		// }
    convTime = iter * 10; //add it to struct for the measurement
}

//Read Cell Voltage Registers
void ltc_readcv(hgLTC_State *state){

	uint8_t CMDBuffer_ReadVR[8];
  uint8_t cellN = 0;
	uint8_t mPos;

	uint8_t CMDStream_ReadVR[5][4] = {
	            { 0x0, 0x4, 0x7, 0xC2 },
	            { 0x0, 0x6, 0x9A, 0x94 },
	            { 0x0, 0x8, 0x5E, 0x52 },
	            { 0x0, 0xA, 0xC3, 0x4 },
	            { 0x0, 0x9, 0xD5, 0x60 } };

	mercury_ltc_wakeSleep();

	for (int16_t i = 0; i < 5; i++) {
  		mercury_ltc_csLow();
  		mercury_spi_read_seq(CMDStream_ReadVR[i], 4, CMDBuffer_ReadVR, 8);
  		mercury_ltc_csHigh();
			mPos = 0;
  		for (int16_t j = 0; j < 3; j++) {
    			state->cellVolts[cellN] = CMDBuffer_ReadVR[mPos] + (CMDBuffer_ReadVR[mPos + 1] << 8);
    			cellN += 1;
    			mPos += 2;
		}
	}

}
```

## src/hg_ltc.h
```c
#ifndef HG_LTC_H
#define HG_LTC_H

#include "hg_spi.h"

#define LTC_NCELLS	   16 //16 cells per cmb.  2 strings of 6 cmbs. ATTENTION: this value requires change in prj.conf: TX_MSG_SEG 
#define CV_SIZE		    1 //1CV= 1 Bytes. Do not change. Currently code supports only 8 bit CV values!

#define LTC_CS_PIN	   3
#define LTC_CS_PIN_DEV device_get_binding("GPIO_0")

static const uint16_t crc15Table[256] = { 0x0,	  0xc599, 0xceab, 0xb32,  0xd8cf, 0x1d56, 0x1664, 0xd3fd, 0xf407, 0x319e, 0x3aac, // precomputed CRC15 Table
										  0xff35, 0x2cc8, 0xe951, 0xe263, 0x27fa, 0xad97, 0x680e, 0x633c, 0xa6a5, 0x7558, 0xb0c1, 0xbbf3, 0x7e6a, 0x5990, 0x9c09, 0x973b, 0x52a2, 0x815f, 0x44c6, 0x4ff4, 0x8a6d, 0x5b2e, 0x9eb7, 0x9585, 0x501c,
										  0x83e1, 0x4678, 0x4d4a, 0x88d3, 0xaf29, 0x6ab0, 0x6182, 0xa41b, 0x77e6, 0xb27f, 0xb94d, 0x7cd4, 0xf6b9, 0x3320, 0x3812, 0xfd8b, 0x2e76, 0xebef, 0xe0dd, 0x2544, 0x2be,  0xc727, 0xcc15, 0x98c,  0xda71,
										  0x1fe8, 0x14da, 0xd143, 0xf3c5, 0x365c, 0x3d6e, 0xf8f7, 0x2b0a, 0xee93, 0xe5a1, 0x2038, 0x7c2,  0xc25b, 0xc969, 0xcf0,  0xdf0d, 0x1a94, 0x11a6, 0xd43f, 0x5e52, 0x9bcb, 0x90f9, 0x5560, 0x869d, 0x4304,
										  0x4836, 0x8daf, 0xaa55, 0x6fcc, 0x64fe, 0xa167, 0x729a, 0xb703, 0xbc31, 0x79a8, 0xa8eb, 0x6d72, 0x6640, 0xa3d9, 0x7024, 0xb5bd, 0xbe8f, 0x7b16, 0x5cec, 0x9975, 0x9247, 0x57de, 0x8423, 0x41ba, 0x4a88,
										  0x8f11, 0x57c,  0xc0e5, 0xcbd7, 0xe4e,  0xddb3, 0x182a, 0x1318, 0xd681, 0xf17b, 0x34e2, 0x3fd0, 0xfa49, 0x29b4, 0xec2d, 0xe71f, 0x2286, 0xa213, 0x678a, 0x6cb8, 0xa921, 0x7adc, 0xbf45, 0xb477, 0x71ee,
										  0x5614, 0x938d, 0x98bf, 0x5d26, 0x8edb, 0x4b42, 0x4070, 0x85e9, 0xf84,  0xca1d, 0xc12f, 0x4b6,  0xd74b, 0x12d2, 0x19e0, 0xdc79, 0xfb83, 0x3e1a, 0x3528, 0xf0b1, 0x234c, 0xe6d5, 0xede7, 0x287e, 0xf93d,
										  0x3ca4, 0x3796, 0xf20f, 0x21f2, 0xe46b, 0xef59, 0x2ac0, 0xd3a,  0xc8a3, 0xc391, 0x608,  0xd5f5, 0x106c, 0x1b5e, 0xdec7, 0x54aa, 0x9133, 0x9a01, 0x5f98, 0x8c65, 0x49fc, 0x42ce, 0x8757, 0xa0ad, 0x6534,
										  0x6e06, 0xab9f, 0x7862, 0xbdfb, 0xb6c9, 0x7350, 0x51d6, 0x944f, 0x9f7d, 0x5ae4, 0x8919, 0x4c80, 0x47b2, 0x822b, 0xa5d1, 0x6048, 0x6b7a, 0xaee3, 0x7d1e, 0xb887, 0xb3b5, 0x762c, 0xfc41, 0x39d8, 0x32ea,
										  0xf773, 0x248e, 0xe117, 0xea25, 0x2fbc, 0x846,  0xcddf, 0xc6ed, 0x374,  0xd089, 0x1510, 0x1e22, 0xdbbb, 0xaf8,  0xcf61, 0xc453, 0x1ca,  0xd237, 0x17ae, 0x1c9c, 0xd905, 0xfeff, 0x3b66, 0x3054, 0xf5cd,
										  0x2630, 0xe3a9, 0xe89b, 0x2d02, 0xa76f, 0x62f6, 0x69c4, 0xac5d, 0x7fa0, 0xba39, 0xb10b, 0x7492, 0x5368, 0x96f1, 0x9dc3, 0x585a, 0x8ba7, 0x4e3e, 0x450c, 0x8095 };

typedef struct {
	uint8_t cellVolts[LTC_NCELLS]; //designed only to support 1 Byte values 
} hgLTC_State;

extern hgLTC_State cmbData; // merge both

void	mercury_ltc_wakeIdle();
void	mercury_ltc_wakeSleep();
int16_t mercury_ltc_init();
int16_t mercury_ltc_updateState(hgLTC_State *state);
uint16_t mercury_ltc_calcPEC(uint8_t  len,  uint8_t *data );

void mercury_ltc_csLow();
void mercury_ltc_csHigh();

void read_fake_cv(uint8_t* arr);
void poll_fake_cv();
/*Mesh stuff*/

#endif
```
